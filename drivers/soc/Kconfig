## drivers/soc/Kconfig
```kconfig
# SPDX-License-Identifier: GPL-2.0-only
menu "SOC (System On Chip) specific Drivers"

source "drivers/soc/qcom/Kconfig"
source "drivers/soc/samsung/Kconfig"

endmenu
```
